/* ////////////////////////////////////////////////////////////////////////////
// 9S12X Program: SCITest - Interface pc and board with SCI
// Processor:     MC9S12XDP512
// Bus Speed:     20 MHz (Requires Active PLL)
// Author:        Andrew Belter
// Details:       Initial testing of interfacing image processing with 9S12 through SCI
// Date:          Feb. 12, 2023
/////////////////////////////////////////////////////////////////////////// */
#include <hidef.h>      /* common defines and macros */
#include "derivative.h" /* derivative-specific definitions */
#include "pll.h"        /* increase bus speed */
#include "swled.h"      /* switches and LEDs */
#include "timer.h"      /* timer library */
#include "segs.h"       /* 7 segs library */
#include "lcd.h"        /* LCD library */
#include "pit.h"        /* PIT library */
#include "misc.h"       /* Misc library */
#include "pulse.h"      /* PWM Pulse library */
#include "sci.h"        /* SCI Library */
#include "escseq.h"     /* Escape Sequency Library */
#include "atod.h"       /* AtoD library */

// other system includes or your includes go here
// #include <stdlib.h>
// #include <stdio.h>

/////////////////////////////////////////////////////////////////////////////
// Local Prototypes
/////////////////////////////////////////////////////////////////////////////

/////////////////////////////////////////////////////////////////////////////
// Global Variables
/////////////////////////////////////////////////////////////////////////////

/////////////////////////////////////////////////////////////////////////////
// Constants
/////////////////////////////////////////////////////////////////////////////

/////////////////////////////////////////////////////////////////////////////
// Main Entry
/////////////////////////////////////////////////////////////////////////////
void main(void)
{

  /////////////////////////////////////////////////////////////////////////////
  // Local Variables
  /////////////////////////////////////////////////////////////////////////////

  // main entry point - these two lines must appear first
  _DISABLE_COP();
  EnableInterrupts;

  /////////////////////////////////////////////////////////////////////////////
  // one-time initializations
  /////////////////////////////////////////////////////////////////////////////
  PLL_To20MHz();
  SWLInit();
  LCD_Init();
  SCI0_Init(20E6, BaudRate_9600, SCI_RDRF_InterruptOff);

  /////////////////////////////////////////////////////////////////////////////
  // main program loop
  /////////////////////////////////////////////////////////////////////////////
  for (;;)
  {
    if (SWLPressed(SWLMiddle))
    {
      unsigned char responce;
      SCI0_TxByte_Block('a');
      responce = SCI0_BRead();
      switch (responce)
      {
      case 'r':
        LCD_StringXY(0, 0, "Colour: Red  ");
        break;
      case 'g':
        LCD_StringXY(0, 0, "Colour: Green");
        break;
      case 'b':
        LCD_StringXY(0, 0, "Colour: Blue ");
        break;
      case 'w':
        LCD_StringXY(0, 0, "Colour: White");
        break;
      case 'k':
        LCD_StringXY(0, 0, "Colour: Black");
        break;
      default:
        LCD_StringXY(0, 0, "Colour: Other");
        break;
      }
      while (!SWLPressed(SWLUp))
        ;
    }
  } // end main program loop
} // end main method

/////////////////////////////////////////////////////////////////////////////
// Functions
/////////////////////////////////////////////////////////////////////////////

/////////////////////////////////////////////////////////////////////////////
// Interrupt Service Routines
/////////////////////////////////////////////////////////////////////////////
